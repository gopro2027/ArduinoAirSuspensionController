## Wireless_Controller/device_libs/ws2p8/ESP-IDF/ESP32-S3-Touch-LCD-2.8-Test/main/Kconfig.projbuild
```kconfig
menu "Example Configuration"
    config LV_MEM_SIZE_KILOBYTES
        int "Size of the memory used by `lv_mem_alloc` in kilobytes (>= 2kB)"
        default 48
            
    config LV_USE_DEMO_WIDGETS
        bool "Show some widget"
        default y
        
    config LV_DEMO_WIDGETS_SLIDESHOW
        bool "Enable slide show"
        depends on LV_USE_DEMO_WIDGETS
        default y

    config LV_USE_DEMO_KEYPAD_AND_ENCODER
        bool "Demonstrate the usage of encoder and keyboard"
        default y

    config LV_USE_DEMO_BENCHMARK
        bool "Benchmark your system"
        default y

    config LV_USE_DEMO_STRESS
        bool "Stress test for LVGL"
        default y

    config LV_USE_DEMO_MUSIC
        bool "Music player demo"
        default y

    
    config LV_FONT_MONTSERRAT_12
        bool "Enable Montserrat 12"
        default y if !LV_CONF_MINIMAL

    config LV_FONT_MONTSERRAT_14
        bool "Enable Montserrat 14"
        default y if !LV_CONF_MINIMAL

    config LV_FONT_MONTSERRAT_16
        bool "Enable Montserrat 16"
        default y if !LV_CONF_MINIMAL
        


    config BT_ENABLED
        bool "Select this option to enable Bluetooth"
        default y 

    config BT_BLE_50_FEATURES_SUPPORTED
        bool "Enabling this option activates BLE 5.0 features"
        default y 
        
    config BT_BLE_42_FEATURES_SUPPORTED
        bool "This enables BLE 4.2 features."
        default y 
endmenu
```

## Wireless_Controller/device_libs/ws2p8/ESP-IDF/ESP32-S3-Touch-LCD-2.8-Test/sdkconfig.defaults
```kconfig
CONFIG_SPIRAM=y
CONFIG_SPIRAM_MODE_OCT=y
CONFIG_SPIRAM_SPEED_80M=y

CONFIG_LV_USE_USER_DATA=y
CONFIG_LV_USE_CHART=y
CONFIG_LV_USE_PERF_MONITOR=y

CONFIG_ESP32S3_DATA_CACHE_LINE_64B=y
CONFIG_ESP32S3_DATA_CACHE_LINE_SIZE=64

CONFIG_FATFS_LFN_STACK=y
CONFIG_FATFS_MAX_LFN=255
CONFIG_FATFS_API_ENCODING_ANSI_OEM=y

CONFIG_ESPTOOLPY_FLASHSIZE_16MB=y
CONFIG_PARTITION_TABLE_CUSTOM=y

CONFIG_ESP_DEFAULT_CPU_FREQ_MHZ_240=y



#CONFIG_FREERTOS_HZ=1000

#CONFIG_ESPTOOLPY_FLASHMODE_QIO=y
#CONFIG_ESPTOOLPY_FLASHFREQ_120M=y
#CONFIG_SPIRAM_MODE_OCT=y

#CONFIG_IDF_EXPERIMENTAL_FEATURES=y
#CONFIG_SPIRAM_SPEED_120M=y

#CONFIG_SPIRAM_FETCH_INSTRUCTIONS=y
#CONFIG_SPIRAM_RODATA=y
#CONFIG_ESP32S3_DATA_CACHE_LINE_64B=y
#CONFIG_COMPILER_OPTIMIZATION_PERF=y
```

## Wireless_Controller/device_libs/ws2p8b/ESP-IDF/ESP32-S3-Touch-LCD-2.8B-Test/main/Kconfig.projbuild
```kconfig
menu "Example Configuration"
    config EXAMPLE_DOUBLE_FB
        bool "Use double Frame Buffer"
        default n
        help
            Enable this option, driver will allocate two frame buffers.
    config EXAMPLE_USE_BOUNCE_BUFFER
        depends on !EXAMPLE_DOUBLE_FB
        bool "Use bounce buffer"
        default y
        help
            Enable bounce buffer mode can achieve higher PCLK frequency at the cost of higher CPU consumption.

    config EXAMPLE_AVOID_TEAR_EFFECT_WITH_SEM
        depends on !EXAMPLE_DOUBLE_FB
        bool "Avoid tearing effect"
        default y
        help
            Enable this option, the example will use a pair of semaphores to avoid the tearing effect.
            Note, if the Double Frame Buffer is used, then we can also avoid the tearing effect without the lock.

            
    config LV_USE_DEMO_WIDGETS
        bool "Show some widget"
        default y
        
    config LV_DEMO_WIDGETS_SLIDESHOW
        bool "Enable slide show"
        depends on LV_USE_DEMO_WIDGETS
        default y

    config LV_USE_DEMO_KEYPAD_AND_ENCODER
        bool "Demonstrate the usage of encoder and keyboard"
        default y

    config LV_USE_DEMO_BENCHMARK
        bool "Benchmark your system"
        default y

    config LV_USE_DEMO_STRESS
        bool "Stress test for LVGL"
        default y

    config LV_USE_DEMO_MUSIC
        bool "Music player demo"
        default y

    
    config LV_FONT_MONTSERRAT_12
        bool "Enable Montserrat 12"
        default y if !LV_CONF_MINIMAL

    config LV_FONT_MONTSERRAT_14
        bool "Enable Montserrat 14"
        default y if !LV_CONF_MINIMAL

    config LV_FONT_MONTSERRAT_16
        bool "Enable Montserrat 16"
        default y if !LV_CONF_MINIMAL
        


    config BT_ENABLED
        bool "Select this option to enable Bluetooth"
        default y 

    config BT_BLE_50_FEATURES_SUPPORTED
        bool "Enabling this option activates BLE 5.0 features"
        default y 
        
    config BT_BLE_42_FEATURES_SUPPORTED
        bool "This enables BLE 4.2 features."
        default y 
endmenu

 
```

## Wireless_Controller/device_libs/ws2p8b/ESP-IDF/ESP32-S3-Touch-LCD-2.8B-Test/sdkconfig.defaults
```kconfig
CONFIG_LV_MEM_CUSTOM=y
CONFIG_LV_MEMCPY_MEMSET_STD=y
CONFIG_LV_USE_USER_DATA=y
CONFIG_LV_USE_CHART=y
CONFIG_LV_USE_PERF_MONITOR=y

CONFIG_ESPTOOLPY_FLASHSIZE_16MB=y
CONFIG_PARTITION_TABLE_CUSTOM=y

CONFIG_ESP32S3_DATA_CACHE_LINE_64B=y
CONFIG_ESP32S3_DATA_CACHE_LINE_SIZE=64

CONFIG_ESP32S3_DEFAULT_CPU_FREQ_240=y
CONFIG_ESP32S3_DEFAULT_CPU_FREQ_MHZ=240
```

## Wireless_Controller/device_libs/ws3p5b/ESP-IDF/06_lvgl_image/sdkconfig.defaults
```kconfig
CONFIG_IDF_TARGET="esp32s3"

CONFIG_ESPTOOLPY_FLASHSIZE_16MB=y
CONFIG_ESPTOOLPY_FLASHMODE_QIO=y

CONFIG_PARTITION_TABLE_CUSTOM=y

CONFIG_ESP_DEFAULT_CPU_FREQ_MHZ_240=y

CONFIG_SPIRAM=y
CONFIG_SPIRAM_MODE_OCT=y
CONFIG_SPIRAM_SPEED_80M=y

CONFIG_LV_COLOR_16_SWAP=y
CONFIG_LV_FONT_MONTSERRAT_12=y
CONFIG_LV_FONT_MONTSERRAT_16=y
CONFIG_LV_FONT_MONTSERRAT_20=y
CONFIG_LV_USE_DEMO_WIDGETS=y
CONFIG_LV_USE_DEMO_BENCHMARK=y
CONFIG_LV_USE_DEMO_STRESS=y
CONFIG_LV_USE_DEMO_MUSIC=y

## LVGL8 ##
CONFIG_LV_MEM_SIZE_KILOBYTES=48
```
